## main/Kconfig.projbuild
```kconfig
menu "Example Configuration"
    menuconfig EXAMPLE_AGENTS_ENABLE_OPENAI
        bool "Enable OpenAI agent (Doubao/豆包 via OpenAI-compatible API)"
        select BROOKESIA_AGENT_OPENAI_ENABLE_AUTO_REGISTER
        default y

    if EXAMPLE_AGENTS_ENABLE_OPENAI
        config EXAMPLE_AGENTS_OPENAI_API_KEY
            string "API key"
            default "sk-your-api-key-here"

        config EXAMPLE_AGENTS_OPENAI_MODEL
            string "Model"
            default "doubao-realtime"

        config EXAMPLE_AGENTS_OPENAI_VOICE
            string "Voice"
            default "alloy"

        config EXAMPLE_AGENTS_OPENAI_APP_ID
            string "Volcano Ark App ID"
            default ""
    endif

    menuconfig EXAMPLE_AGENTS_ENABLE_XIAOZHI
        bool "Enable Xiaozhi agent"
        select BROOKESIA_AGENT_XIAOZHI_ENABLE_AUTO_REGISTER
        default y
endmenu

menu "Display (屏幕) Configuration"
    menuconfig APP_ENABLE_DISPLAY
        bool "Enable display (LCD + LVGL UI) support"
        default n
        help
            开启后编译 main/modules/display/ 屏幕模块（LVGL UI + 表情 emote + 手势）。
            当前无屏硬件保持关闭；以后接上屏幕（如 ESP32-S3-LCD-EV 板载
            ST7789/GC9A01 面板）后打开此项并在 menuconfig 里使能
            BROOKESIA_HAL_ADAPTOR_ENABLE_DISPLAY_DEVICE 及 LCD 面板驱动即可。

    if APP_ENABLE_DISPLAY
        config APP_DISPLAY_EMOTE_ASSETS
            bool "Load emote assets from storage partition"
            default y
    endif
endmenu
```

## sdkconfig.defaults
```kconfig
CONFIG_IDF_TARGET="esp32s3"

# Flash & PSRAM N16R8
CONFIG_ESPTOOLPY_FLASHMODE_QIO=y
CONFIG_ESPTOOLPY_FLASHSIZE_16MB=y
CONFIG_SPIRAM=y
CONFIG_SPIRAM_MODE_OCT=y
CONFIG_SPIRAM_SPEED_80M=y
CONFIG_SPIRAM_USE_MALLOC=y
CONFIG_SPIRAM_TRY_ALLOCATE_WIFI_LWIP=y
CONFIG_SPIRAM_MALLOC_ALWAYSINTERNAL=2048
CONFIG_SPIRAM_MALLOC_RESERVE_INTERNAL=32768
CONFIG_SPIRAM_ALLOW_BSS_SEG_EXTERNAL_MEMORY=y

# TLS record buffer (LOCAL FIX 2026-10-29~11-03: TTS 大帧 16384B 完整接收根因修复,
# IN=16384 且关闭 VARIABLE_BUFFER_LENGTH; 缺失此三项云编译固件会重现断音/无声音)
CONFIG_MBEDTLS_SSL_IN_CONTENT_LEN=16384
CONFIG_MBEDTLS_SSL_OUT_CONTENT_LEN=2048
CONFIG_MBEDTLS_ASYMMETRIC_CONTENT_LEN=y
# CONFIG_MBEDTLS_SSL_VARIABLE_BUFFER_LENGTH is not set

# WiFi buffer optimization for Doubao realtime audio
CONFIG_ESP_WIFI_STATIC_RX_BUFFER_NUM=4
CONFIG_ESP_WIFI_DYNAMIC_RX_BUFFER_NUM=16
CONFIG_ESP_WIFI_STATIC_TX_BUFFER=y
CONFIG_ESP_WIFI_STATIC_TX_BUFFER_NUM=2

CONFIG_ESP_WIFI_DYNAMIC_RX_MGMT_BUFFER=y
CONFIG_ESP_WIFI_MGMT_SBUF_NUM=8
CONFIG_ESP_WIFI_MGMT_SBUF_SIZE=512
CONFIG_ESP_WIFI_RX_BA_WIN=8

CONFIG_ESP_WIFI_NVS_ENABLED=n

# UART console & log level
CONFIG_ESP_CONSOLE_UART_DEFAULT=y
CONFIG_LOG_DEFAULT_LEVEL_INFO=y

# Partition table
CONFIG_PARTITION_TABLE_CUSTOM=y
CONFIG_PARTITION_TABLE_CUSTOM_FILENAME="partitions.csv"
CONFIG_PARTITION_TABLE_FILENAME="partitions.csv"

# FreeRTOS / Stack
CONFIG_FREERTOS_HZ=1000
CONFIG_ESP_MAIN_TASK_STACK_SIZE=4096
CONFIG_ESP_TASK_WDT_TIMEOUT_S=10
CONFIG_ESP_SYSTEM_EVENT_TASK_STACK_SIZE=4096

# TLS (Doubao WSS skip cert verify)
CONFIG_ESP_TLS_INSECURE=y
CONFIG_ESP_TLS_SKIP_SERVER_CERT_VERIFY=y
CONFIG_MBEDTLS_CERTIFICATE_BUNDLE=y
CONFIG_MBEDTLS_CERTIFICATE_BUNDLE_DEFAULT_FULL=y
CONFIG_MBEDTLS_EXTERNAL_MEM_ALLOC=y
CONFIG_MBEDTLS_DYNAMIC_BUFFER=y
CONFIG_MBEDTLS_SSL_KEEP_PEER_CERTIFICATE=n

# Brookesia Agent auto-register
CONFIG_BROOKESIA_AGENT_OPENAI_ENABLE_AUTO_REGISTER=y
CONFIG_BROOKESIA_AGENT_XIAOZHI_ENABLE_AUTO_REGISTER=y

# 播放默认音量拉满（LOCAL FIX 2026-11-04：用户要求声音调大；MAX98357A 数字音量由 codec 驱动映射）
CONFIG_BROOKESIA_SERVICE_AUDIO_PLAYBACK_VOLUME_DEFAULT=100

# esp_xiaozhi
CONFIG_XIAOZHI_SYNC_SYSTEM_TIME_FROM_SERVER=n

# Brookesia Utils
CONFIG_BROOKESIA_UTILS_LOG_ENABLE_FILE_AND_LINE=n
CONFIG_BROOKESIA_UTILS_LOG_ENABLE_FUNCTION_NAME=n

# Brookesia HalAdaptor devices
CONFIG_BROOKESIA_HAL_ADAPTOR_ENABLE_SYSTEM_DEVICE=y
CONFIG_BROOKESIA_HAL_ADAPTOR_SYSTEM_ENABLE_RESTART_IMPL=y
CONFIG_BROOKESIA_HAL_ADAPTOR_ENABLE_NETWORK_DEVICE=y
CONFIG_BROOKESIA_HAL_ADAPTOR_NETWORK_ENABLE_SNTP_CLIENT_IMPL=y
CONFIG_BROOKESIA_HAL_ADAPTOR_ENABLE_AUDIO_DEVICE=y
CONFIG_BROOKESIA_HAL_ADAPTOR_AUDIO_ENABLE_CODEC_PLAYER_IMPL=y
CONFIG_BROOKESIA_HAL_ADAPTOR_AUDIO_ENABLE_CODEC_RECORDER_IMPL=y
CONFIG_BROOKESIA_HAL_ADAPTOR_AUDIO_ENABLE_PROCESSOR_IMPL=y
CONFIG_VIDEO_PROCESSOR_ENABLE=n
CONFIG_AUDIO_AFE_ENABLE=n
CONFIG_AUDIO_HLS_ENABLE=n
CONFIG_BROOKESIA_HAL_ADAPTOR_ENABLE_STORAGE_DEVICE=y
CONFIG_BROOKESIA_HAL_ADAPTOR_STORAGE_ENABLE_KEY_VALUE_IMPL=y
CONFIG_BROOKESIA_HAL_ADAPTOR_ENABLE_WIFI_DEVICE=y
CONFIG_BROOKESIA_HAL_ADAPTOR_WIFI_SOFTAP_PROVISION_DNS_THREAD_STACK_SIZE=8192

# esp_board_manager peripherals
CONFIG_ESP_BOARD_PERIPH_I2S_SUPPORT=y
CONFIG_ESP_BOARD_PERIPH_GPIO_SUPPORT=y
CONFIG_ESP_BOARD_DEV_AUDIO_CODEC_SUPPORT=y

# lwIP sockets & TCP buffers for Doubao audio stream
CONFIG_LWIP_MAX_SOCKETS=16
CONFIG_LWIP_TCP_SND_BUF_DEFAULT=11680
CONFIG_LWIP_TCP_WND_DEFAULT=11680
CONFIG_LWIP_TCP_RECVMBOX_SIZE=12

# WebSocket client buffer for Doubao audio
CONFIG_ESP_WS_CLIENT_ENABLE_DYNAMIC_BUFFER=y
CONFIG_WS_BUFFER_SIZE=16384

# Brookesia thread stack (internal RAM)
CONFIG_BROOKESIA_UTILS_THREAD_CONFIG_STACK_IN_EXT=n
CONFIG_BROOKESIA_SERVICE_MANAGER_WORKER_STACK_IN_EXT=n
CONFIG_BROOKESIA_SERVICE_MANAGER_WORKER_STACK_SIZE=12288
CONFIG_BROOKESIA_SERVICE_MANAGER_SECONDARY_SCHEDULER_WORKER_STACK_SIZE=6144

# ASP player trim (Doubao WSS direct, no HTTP/FILE/resample)
CONFIG_ESP_AUDIO_SIMPLE_PLAYER_HTTP_EN=n
CONFIG_ESP_AUDIO_SIMPLE_PLAYER_FILE_EN=n
CONFIG_ESP_AUDIO_SIMPLE_PLAYER_EMBED_FLASH_EN=n
CONFIG_ESP_AUDIO_SIMPLE_PLAYER_RESAMPLE_EN=n
CONFIG_ESP_AUDIO_SIMPLE_PLAYER_BIT_CVT_EN=n
CONFIG_BROOKESIA_UTILS_THREAD_CONFIG_STACK_SIZE=8192
CONFIG_BROOKESIA_SERVICE_MANAGER_WORKER_NUM=2
```

## vendor/av_processor/esp_xiaozhi/sdkconfig.defaults.esp32c3
```kconfig
CONFIG_SR_WN_WN9S_NIHAOXIAOZHI=y

CONFIG_ESPTOOLPY_FLASHSIZE_4MB=y
CONFIG_PARTITION_TABLE_CUSTOM_FILENAME="partitions.csv"
CONFIG_ESP_WIFI_STATIC_RX_BUFFER_NUM=3
CONFIG_ESP_WIFI_DYNAMIC_RX_BUFFER_NUM=4
CONFIG_ESP_WIFI_AMPDU_TX_ENABLED=n
CONFIG_ESP_WIFI_RX_BA_WIN=4
CONFIG_ESP_WIFI_ENABLE_WPA3_SAE=n
CONFIG_ESP_WIFI_ESPNOW_MAX_ENCRYPT_NUM=0
CONFIG_ESP_WIFI_ENTERPRISE_SUPPORT=n
CONFIG_ESP_CONSOLE_USB_SERIAL_JTAG=y
CONFIG_ESP_MAIN_TASK_STACK_SIZE=7168
CONFIG_FREERTOS_HZ=1000
CONFIG_FREERTOS_IDLE_TASK_STACKSIZE=768
CONFIG_LWIP_MAX_SOCKETS=10
CONFIG_LWIP_TCPIP_RECVMBOX_SIZE=16
CONFIG_LWIP_IPV6=n
CONFIG_LWIP_DNS_SUPPORT_MDNS_QUERIES=n
CONFIG_LWIP_DHCPS=n
CONFIG_LWIP_MAX_ACTIVE_TCP=8
CONFIG_LWIP_MAX_LISTENING_TCP=8
CONFIG_LWIP_MAX_UDP_PCBS=8
CONFIG_LWIP_TCPIP_TASK_STACK_SIZE=2048
CONFIG_MBEDTLS_DYNAMIC_FREE_CONFIG_DATA=y
CONFIG_MBEDTLS_SSL_IN_CONTENT_LEN=4096
CONFIG_MBEDTLS_SSL_OUT_CONTENT_LEN=4096
CONFIG_MBEDTLS_CERTIFICATE_BUNDLE_DEFAULT_CMN=y
# CONFIG_MBEDTLS_CERTIFICATE_BUNDLE_DEFAULT_FULL is not set
CONFIG_NEWLIB_NANO_FORMAT=y
CONFIG_MMAP_FILE_NAME_LENGTH=25
CONFIG_ESP_CONSOLE_USB_SERIAL_JTAG=y
CONFIG_USE_ESP_WAKE_WORD=y
CONFIG_COMPILER_OPTIMIZATION_SIZE=y
CONFIG_MCP_TOOLCALL_STACK_SIZE=4096
CONFIG_MCP_TOOLLIST_MAX_SIZE=2048

CONFIG_ESP_BOARD_ESP_HI_SKILL=y
CONFIG_ESP_BOARD_NAME="esp_hi_skill"
CONFIG_EXAMPLE_WIFI_SSID="Redmi_7BDB_2.4G"
CONFIG_EXAMPLE_WIFI_PASSWORD="12345678"
CONFIG_ESP_WIFI_DYNAMIC_TX_BUFFER_NUM=16
CONFIG_ESP_WIFI_MGMT_SBUF_NUM=16
CONFIG_ESP_WIFI_SOFTAP_SUPPORT=n
CONFIG_MQTT_TRANSPORT_WEBSOCKET=n
CONFIG_MQTT_TRANSPORT_WEBSOCKET_SECURE=n

CONFIG_CODEC_DUMMY_SUPPORT=y
CONFIG_CODEC_DATA_ADC_SUPPORT=y

CONFIG_ESP_BOARD_PERIPH_GPIO_SUPPORT=y
CONFIG_ESP_BOARD_PERIPH_I2S_SUPPORT=y
CONFIG_ESP_BOARD_PERIPH_SPI_SUPPORT=y
CONFIG_ESP_BOARD_DEV_AUDIO_CODEC_SUPPORT=y
CONFIG_ESP_BOARD_DEV_BUTTON_SUPPORT=y
CONFIG_ESP_BOARD_DEV_BUTTON_SUB_GPIO_SUPPORT=y
CONFIG_ESP_BOARD_DEV_DISPLAY_LCD_SUPPORT=y
CONFIG_ESP_BOARD_DEV_DISPLAY_LCD_SUB_SPI_SUPPORT=y
```
